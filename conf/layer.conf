## conf/layer.conf
```bitbake
# We have a conf and classes directory, append to BBPATH
BBPATH .= ":${LAYERDIR}"

# We have a recipes directory, add to BBFILES
BBFILES += "${LAYERDIR}/recipes-*/*/*.bb ${LAYERDIR}/recipes-*/*/*.bbappend"

BBFILE_COLLECTIONS += "television-hardware-jp-layer"
BBFILE_PATTERN_television-hardware-jp-layer := "^${LAYERDIR}/"
BBFILE_PRIORITY_television-hardware-jp-layer = "7"

LAYERDEPENDS_television-hardware-jp-layer = "rust-layer"
LAYERSERIES_COMPAT_television-hardware-jp-layer = "kirkstone"

# Specify versions
require conf/distro/include/rust_versions.inc
```
